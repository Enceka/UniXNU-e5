## configs/e5_defconfig
```kconfig
CONFIG_XNU_BUILD_ARCHIVES=y
CONFIG_XNU_ARMVIRT_PLATFORM=n
CONFIG_XNU_NATIVE_RAM_BLOCK=y
CONFIG_XNU_OWNER_BOOT_MANIFEST=y
CONFIG_XNU_OWNER_DATA_MOUNT=y
CONFIG_XNU_OWNER_DATA_VOLUME_UUID="B5A22774-89CF-41E5-A62B-5AFA6B2710BC"
CONFIG_XNU_EXTRA_LD_ARCHIVES="-Wl,-force_load,{tree}/build/e5-emmc/libE5Emmc.a"
```
