// SPDX-License-Identifier: BSD-3-Clause
/dts-v1/;
/include/ "ums9621.dtsi"

/ {
    model = "Rongyue E5";
    compatible = "rongyue,e5", "sprd,ums9621";

    memory@80000000 {
        device_type = "memory";
        reg = <0 0x80000000 0 0x80000000>;
    };

    soc {
        #address-cells = <2>;
        #size-cells = <2>;
        ranges;

        // v2 display bring-up: IOMobileFramebufferLegacy expects a provider
        // service named "lcd" (AppleARMPlatform publishes ADT device nodes
        // as IOPlatformDevice/AppleARMIODevice instances).
        lcd@0 {
            compatible = "lcd";
            device_type = "display-subsystem";
            unixnu,adt-name = "lcd";
            // Provider contract the IOMobileFramebuffer family reads at start
            // and on pitch/dimension queries (docs/display-provider-contract.md;
            // tuple verified since r78: 320x480 RGB565, row 640).
            framebuffer-width = <320>;
            framebuffer-height = <480>;
            dot-pitch = <123>;
        };
    };
};
